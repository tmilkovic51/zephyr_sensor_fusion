## Kconfig
```kconfig
# Copyright (c) 2024 Tomislav Milkovic
# SPDX-License-Identifier: MIT

config SENSOR_FUSION_AHRS
    bool "Enable AHRS sensor fusion module"
    default y
    depends on DT_HAS_ZEPHYR_SENSOR_FUSION_AHRS_ENABLED
    depends on SENSOR
    help
      Enable the attitude and heading reference system (AHRS) sensor
      fusion module. This module samples the accelerometer, gyroscope
      and (optionally) magnetometer data and uses that data to calculate
      four outputs: quaternion, gravity, linear acceleration, and Earth
      acceleration. This can be converted to a rotation matrix or to Euler
      angles.

      This module requires a device tree node with `zephyr,sensor-fusion-ahrs`
      compatible to be defined and enabled in board device tree. Refer to
      dts/bindings/sensor/zephyr,sensor-fusion-ahrs.yaml file to see which
      properties need to be configured in this device tree node.

if SENSOR_FUSION_AHRS

config SENSOR_FUSION_AHRS_ACCEL_ZERO_TRIM_THRESHOLD_MILLIG
    int "AHRS acceleration threshold which will be trimmed to 0"
    default 350
    help
      Algorithm will trim acceleration values lower than this option to 0.
      Default value is 350 millig (0.35 g).

config SENSOR_FUSION_AHRS_GYRO_ZERO_TRIM_THRESHOLD_MILLIDEGREES
    int "AHRS rotational speed threshold which will be trimmed to 0"
    default 2100
    help
      Algorithm will trim rotational speed values lower than this option to 0.
      Default value is 2100 millidegrees (2.1 degrees).

# Logging subsystem configuration:
module = SENSOR_FUSION_AHRS
module-str = sensor_fusion_ahrs
source "subsys/logging/Kconfig.template.log_config"

endif # SENSOR_FUSION_AHRS
```

## dts/bindings/sensor/zephyr,sensor-fusion-ahrs.yaml
```yaml
# Copyright (c) 2024 Tomislav Milkovic
# SPDX-License-Identifier: MIT

description: |
  Sensor Fusion based on the AHRS algorithm implemented by XIO Technologies.
  See more info at: https://github.com/xioTechnologies/Fusion

  / {
    sensor_fusion: fusion {
      status = "okay";
      compatible = "zephyr,sensor-fusion-ahrs";
      accel-dev = <&accel0>; /* Accelerometer device phandle */
      gyro-dev = <&gyro0>; /* Gyroscope device phandle */
      magn-dev = <&magn0>; /* Magnetometer device phandle */
      earth-axes-convention = <0>; /* North-West-Up convention */
      gyro-gain = <50>; /* Gyroscope gain of 0.5x */
      gyro-range = <250>; /* Gyroscope full scale range: 250 dps */
      accel-rejection = <10>; /* In degrees */
      magn-rejection = <10>; /* In degrees */
      recovery-trigger-period = <500>; /* In samples */
      target-sample-rate-hz = <100>;
    }
  }

include: sensor-device.yaml

compatible: "zephyr,sensor-fusion-ahrs"

properties:
  accel-dev:
    type: phandle
    required: true
    description: |
      Phandle of the accelerometer device to be used for sensor fusion.

  gyro-dev:
    type: phandle
    required: true
    description: |
      Phandle of the gyroscope device to be used for sensor fusion.

  magn-dev:
    type: phandle
    description: |
      Phandle of the magnetometer device to be used for sensor fusion.
      If not present, sensor fusion will be done with accelerometer
      and gyroscope only.

  earth-axes-convention:
    type: int
    description: |
      Earth axes convention. Possible values:
        0 = North-West-Up
        1 = East-North-Up
        2 = North-East-Down
    default: 0
    enum:
      - 0
      - 1
      - 2

  gyro-gain:
    type: int
    description: |
       Determines the influence of the gyroscope relative to other
       sensors, in percent. A value of zero percent will disable
       initialisation and the acceleration and magnetic rejection
       features. A value of 50 is appropriate for most applications.
    default: 50

  gyro-range:
    type: int
    description: |
        Gyroscope range, in degrees per second. Angular rate recovery
        will activate if the gyroscope measurement exceeds 98% of this
        value. A value of zero will disable this feature.
        The value should be set to the range specified in the
        gyroscope datasheet. Default is 250 degrees per second (dps).
    default: 250

  accel-rejection:
    type: int
    description: |
        Threshold (in degrees) used by the acceleration rejection
        feature. A value of zero will disable this feature.
        A value of 10 degrees is appropriate for most applications.
    default: 10

  magn-rejection:
    type: int
    description: |
        Threshold (in degrees) used by the magnetic rejection
        feature. A value of zero will disable the feature.
        A value of 10 degrees is appropriate for most applications.
    default: 10

  recovery-trigger-period:
    type: int
    description: |
        Acceleration and magnetic recovery trigger period, in samples.
        A value of zero will disable the acceleration and magnetic
        rejection features. A period of 5 seconds is appropriate
        for most applications. If collecting 100 samples per second,
        the appropriate value would be 500 samples.
    default: 500

  target-sample-rate-hz:
    type: int
    description: |
        Target sample rate of running the sensor fusion algorithm, in Hz.
        Set this to number of sensor_sample_fetch function calls you plan
        to implement in your application code.
        Default value is 100 Hz (100 times per second).
    default: 100
```

## west.yml
```yaml
# Copyright (c) 2024 Tomislav Milkovic
# SPDX-License-Identifier: MIT

manifest:
  self:
    path: zephyr-xio-sensor-fusion
    # Also update this module's git submodules when running "west update" command:
    submodules: true
```
